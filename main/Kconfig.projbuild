## main/Kconfig.projbuild
```kconfig
menu "Drone Configuration"

    choice EXAMPLE_IP_MODE
        prompt "IP Version"
        depends on EXAMPLE_SOCKET_IP_INPUT_STRING
        help
            Example can use either IPV4 or IPV6.

        config EXAMPLE_IPV4
            bool "IPV4"

        config EXAMPLE_IPV6
            bool "IPV6"
            select EXAMPLE_CONNECT_IPV6

    endchoice

    config WIFI_SSID
        string "Wifi SSID"
        default "safmc-wifi"
        help
            Name of wifi hotspot.

    config WIFI_PASSWORD
        string "Wifi Password"
        default "epic-elliot"
        help 
            Wifi hotspot password.

    config HOST_IPV4_ADDR
        string "IPV4 Address"
        default "192.168.50.160"
        help
            IPV4 address to which the client example will send data.

    config TOF_BRIDGE_PORT
        int "TOF bridge port (outgoing)"
        range 0 65535
        default 3333
        help
          Port number to send TOF data to (outgoing data)

    config MAVROS_BRIDGE_IN_PORT
        int "Mavros bridge port (incoming)"
        range 0 65535
        default 8888
        help
          Port number for central compute to send mavlink packets to (incoming data)

    config MAVROS_BRIDGE_OUT_PORT
        int "Mavros bridge port (outgoing)"
        range 0 65535
        default 14550
        help
          Port number for central compute to send mavlink packets to (incoming data)

    config APRILTAG_SEND_PORT
        int "Port to send apriltag messages to"
        range 0 65535
        default 5000
        help
          Port to send apriltag messages to

    config DRONE_ID
        int "Drone ID (0-30)"
        range 0 30
        default 0
        help
          Unique identifier for this drone. Used in telemetry packets.

    config TELEM_PORT
        int "Telemetry UDP port (outgoing)"
        range 0 65535
        default 5005
        help
          UDP port on the laptop that receives telemetry packets.

    config TOF_FRONT_SENSOR_IDX
        int "Front-facing ToF sensor index (0-7)"
        range 0 7
        default 0
        help
          Which sensor (0-7) physically faces forward.
          Sensors are mounted counter-clockwise, so sensor (N+1) is 45 deg to
          the LEFT of sensor N.  Set this to the index of the sensor that faces
          the drone's nose.

    config TCA_SDA_GPIO_PORT
        int "GPIO I2C SDA"
        range 0 50
        default 1
        help
          GPIO Port of the TCA SDA

    config TCA_SCL_GPIO_PORT
        int "GPIO I2C SCL"
        range 0 50
        default 2
        help
          GPIO Port of the TCA SCL

    config PX4_TX_PIN 
        int "GPIO PX4 TX PIN"
        range 0 50
        default 5
        help
          GPIO PX4 TX PIN

    config PX4_RX_PIN 
        int "GPIO PX4 RX PIN"
        range 0 50
        default 4
        help
          GPIO PX4 RX PIN

endmenu
```

## sdkconfig.defaults
```kconfig
# Allow task pinning to specific cores
CONFIG_FREERTOS_UNICORE=n

# UART ISR in IRAM so WiFi cache misses don't stall it
CONFIG_UART_ISR_IN_IRAM=y

# Enough stack for main task
CONFIG_ESP_MAIN_TASK_STACK_SIZE=4096

# Tick rate — 1000Hz gives 1ms resolution for vTaskDelayUntil
CONFIG_FREERTOS_HZ=1000
```
